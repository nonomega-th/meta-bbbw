## conf/layer.conf
```bitbake
# We have a conf and classes directory, add to BBPATH
BBPATH .= ":${LAYERDIR}"

# We have recipes-* directories, add to BBFILES
BBFILES += "${LAYERDIR}/recipes-*/*/*.bb \
            ${LAYERDIR}/recipes-*/*/*.bbappend"

BBFILE_COLLECTIONS += "bbbwramfs"
BBFILE_PATTERN_bbbwramfs = "^${LAYERDIR}/"
BBFILE_PRIORITY_bbbwramfs = "5"
LAYERVERSION_bbbwramfs = "4"
LAYERSERIES_COMPAT_bbbwramfs = "sumo"
```
